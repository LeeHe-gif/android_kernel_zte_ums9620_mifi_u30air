## drivers/vendor/common/dcmtalk/Kconfig
```kconfig
config DCMTALK_SUPPORT
	tristate "DCMTALK Drivers Support"
	depends on ARM || ARM64
	help
		Say Y here if you want to enable DCMTALK Drivers.
```

## drivers/vendor/common/leds/aw9523b/Kconfig
```kconfig
config ZTE_LEDS_AW9523B
	tristate "ZTE_LEDS_AW9523B"
	depends on I2C
	default n
	help
		  Say Y here if you have crypto breathing light leds chip AW9523B.
		  If unsure, say N.
```

## drivers/vendor/common/sensor/Kconfig
```kconfig
config ZTE_TEMPERATURE_SENSOR
	bool "ZTE_TEMPERATURE SENSOR"
		depends on I2C
		default n
		help
		  Say Y here if you have zte temperature sensor.
		  If unsure, say N.

config CUSTOM_KERNEL_SAR_SENSOR
	bool "ZTE_SAR SENSOR"
		depends on I2C
		default n
		help
		  Say Y here if you have zte sar sensor.
		  If unsure, say N.

config CUSTOM_KERNEL_SKEY_SENSOR
	bool "ZTE_SKEY SENSOR"
		depends on I2C
		default n
		help
		  Say Y here if you have zte sar sensor.
		  If unsure, say N.
		  
config CUSTOM_KERNEL_HALL_SENSOR
	bool "ZTE HALL  SENSOR"
		default n
		help
		  Say Y here if you have zte hall sensor.
		  If unsure, say N.

config CUSTOM_SENSOR_NATIVE_ACC
	tristate "custom sensor native acc with I2C bus"
	depends on I2C
	help
		Say Y here if you use this

source "drivers/vendor/common/sensor/temperature/Kconfig"
source "drivers/vendor/common/sensor/sar/Kconfig"
source "drivers/vendor/common/sensor/skey/Kconfig"
source "drivers/vendor/common/sensor/hall/Kconfig"
source "drivers/vendor/common/sensor/native_acc/Kconfig"
```

## drivers/vendor/common/sensor/native_acc/Kconfig
```kconfig
config NATIVE_ACC_STK8BAXX_I2C
	tristate "ST stk8baxx 3-Axid accelerometer device with I2C bus"
	depends on I2C
	default n
	help
	  Say Y here if you have a stk8baxx device on the board and use I2C
	  communication, else say N.

	  To compile this driver as a module, choose M here.

config NATIVE_ACC_MC3XXX_I2C
	tristate "mCube mc3xxx 3-Axis accelerometer device with I2C bus"
	depends on I2C
	default n
	help
	  Say Y here if you have a mc3xxx device on the board and use I2C
	  communication, else say N.

	  To compile this driver as a module, choose M here.

config NATIVE_ACC_SC7A20_I2C
	tristate "silan sc7a20 3-Axis accelerometer device with I2C bus"
	depends on I2C
	default n
	help
	  Say Y here if you have a sc7a20 device on the board and use I2C
	  communication, else say N.

	  To compile this driver as a module, choose M here.
```
